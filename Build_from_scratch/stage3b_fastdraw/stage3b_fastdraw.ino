// Stage 3b - Fast sprite draw (40 MHz SPI + bulk SPI.writeBytes per row)
// Same commands as Stage 3. Goal: adult < 10 ms, sleep < 15 ms.
// Board: NodeMCU 1.0 | Libraries: Adafruit GFX, Adafruit ST7735
// Display (Stage 0 lock): BLACKTAB, rotation 0, CS D8, DC D3, RST -1, LED D4 PWM
//
// Art: limengdu/reTerminal_Sticky_Bunny (MIT License, (c) 2026 limengdu) - see LICENSE_bunny_art.txt
// pet_frames.h is generated by tools/gen_frames.py (1-bit ink + body mask per frame, PROGMEM)
//
// Serial @115200:
//   n  next stage (egg -> baby -> kid -> teen -> adult -> sleep scene)
//   a  play next action once (hungry / tired / feed / pet / play ...), then back to idle
//   h  hatch animation (egg stage only)
//   m  manual mode: freeze the player, each 'm' shows the next frame
//   b  background toggle (navy / black)
//   t  timing test: draw the current frame 50x, print average draw time
//   ?  status (flash used by frames, heap, last draw time)

#include <Adafruit_GFX.h>
#include <Adafruit_ST7735.h>
#include <SPI.h>
#include "pet_frames.h"

// ---------------------------------------------------------------------
// Stages and animation scripts
// ---------------------------------------------------------------------
struct Step { uint8_t frame; uint16_t ms; };

// frame indexes inside each Sprite table (see pet_frames.h order)
enum { E_INTACT, E_WL, E_WR, E_C1, E_C2, E_OPEN };
enum { B_IDLE, B_BLINK, B_EAR, B_HUNGRY, B_TIRED, B_FEED, B_PET, B_PLAY };   // baby + kid
enum { A_IDLE, A_SIGN, A_FEED, A_PET, A_PLAY };                             // teen + adult

const Step EGG_IDLE[]   = {{E_INTACT,1500},{E_WL,180},{E_WR,180},{E_WL,180},{E_INTACT,1200},{E_WR,180},{E_INTACT,900}};
const Step EGG_HATCH[]  = {{E_INTACT,500},{E_WL,150},{E_WR,150},{E_C1,700},{E_WL,150},{E_C2,700},{E_WR,150},{E_OPEN,2500}};
const Step SMALL_IDLE[] = {{B_IDLE,2500},{B_BLINK,140},{B_IDLE,1800},{B_EAR,350},{B_IDLE,2200},{B_BLINK,120},{B_IDLE,150},{B_BLINK,120}};
const Step BIG_IDLE[]   = {{A_IDLE,2500},{A_SIGN,900},{A_IDLE,3000}};
const Step SLEEP_LOOP[] = {{0,1200},{1,1200}};

const char* SMALL_NAMES[] = {"idle","blink","ear","hungry","tired","feed","pet","play"};
const char* BIG_NAMES[]   = {"idle","signature","feed","pet","play"};
const char* EGG_NAMES[]   = {"intact","wobble L","wobble R","crack 1","crack 2","open"};
const uint8_t SMALL_ACTIONS[] = {B_HUNGRY, B_TIRED, B_FEED, B_PET, B_PLAY};
const uint8_t BIG_ACTIONS[]   = {A_FEED, A_PET, A_PLAY};

struct StageDef {
  const char* name; const Sprite* frames; uint8_t nFrames;
  const Step* idle; uint8_t nIdle; const char** names;
  const uint8_t* actions; uint8_t nActions;
};
#define TFT_CS  D8
#define TFT_DC  D3
#define TFT_RST -1
#define TFT_LED D4
Adafruit_ST7735 tft(TFT_CS, TFT_DC, TFT_RST);

#define C_NAVY   0x10A8
#define C_INK    ST77XX_BLACK
#define C_BODY   ST77XX_WHITE
#define C_TEXT   ST77XX_WHITE
uint16_t bgCol = C_NAVY;

// ---------------------------------------------------------------------
// Flicker-free sprite draw: one pass, one row at a time.
// ink bit -> black, mask bit -> white body, else background.
// ---------------------------------------------------------------------
uint16_t rowBuf[128];
uint32_t lastDrawUs = 0;
const uint32_t SPI_HZ = 40000000;   // Stage 4 test: 40 MHz looks clean

// colours pre-swapped to big-endian so the row goes out as raw bytes
static inline uint16_t be(uint16_t c) { return (c << 8) | (c >> 8); }

void drawSprite(int x, int y, const Sprite& s, uint16_t bg) {
  uint32_t t0 = micros();
  const uint16_t INK = be(C_INK), BODY = be(C_BODY), BG = be(bg);
  int rb = (s.w + 7) / 8;
  tft.startWrite();
  tft.setAddrWindow(x, y, s.w, s.h);          // leaves DC in data mode
  for (int r = 0; r < s.h; r++) {
    const uint8_t* ip = s.ink + r * rb;
    const uint8_t* mp = s.mask ? s.mask + r * rb : nullptr;
    int c = 0;
    for (int bx = 0; bx < rb; bx++) {
      uint8_t ib = pgm_read_byte(ip + bx);
      uint8_t mb = mp ? pgm_read_byte(mp + bx) : 0xFF;
      for (uint8_t bit = 0x80; bit && c < s.w; bit >>= 1, c++)
        rowBuf[c] = (ib & bit) ? INK : ((mb & bit) ? BODY : BG);
    }
    SPI.writeBytes((uint8_t*)rowBuf, s.w * 2);  // one bulk transfer per row
  }
  tft.endWrite();
  lastDrawUs = micros() - t0;
}


#define N(a) (uint8_t)(sizeof(a) / sizeof(a[0]))
const StageDef STAGES[] = {
  {"EGG 48",    EGG,   EGG_N,   EGG_IDLE,   N(EGG_IDLE),   EGG_NAMES,   nullptr,       0},
  {"BABY 56",   BABY,  BABY_N,  SMALL_IDLE, N(SMALL_IDLE), SMALL_NAMES, SMALL_ACTIONS, N(SMALL_ACTIONS)},
  {"KID 68",    KID,   KID_N,   SMALL_IDLE, N(SMALL_IDLE), SMALL_NAMES, SMALL_ACTIONS, N(SMALL_ACTIONS)},
  {"TEEN 80",   TEEN,  TEEN_N,  BIG_IDLE,   N(BIG_IDLE),   BIG_NAMES,   BIG_ACTIONS,   N(BIG_ACTIONS)},
  {"ADULT 96",  ADULT, ADULT_N, BIG_IDLE,   N(BIG_IDLE),   BIG_NAMES,   BIG_ACTIONS,   N(BIG_ACTIONS)},
  {"SLEEP",     SLEEP, 2,       SLEEP_LOOP, N(SLEEP_LOOP), nullptr,     nullptr,       0},
};
const uint8_t N_STAGES = N(STAGES);

// ---------------------------------------------------------------------
// Non-blocking frame player
// ---------------------------------------------------------------------
uint8_t stageIdx = 0;
const Step* script = nullptr; uint8_t scriptLen = 0; uint8_t stepIdx = 0;
bool scriptLoops = true;
uint32_t stepStart = 0;
Step oneShot[1];
uint8_t actionIdx = 0;
bool manual = false; uint8_t manualFrame = 0;
int shownFrame = -1;

const int AREA_Y = 16, AREA_BOTTOM = 144;   // pet area under the header

void showFrame(uint8_t f) {
  const StageDef& st = STAGES[stageIdx];
  const Sprite& s = st.frames[f];
  int x = (128 - s.w) / 2;
  int y = (stageIdx == 5) ? 30 : AREA_BOTTOM - s.h;   // feet stay on the same line
  drawSprite(x, y, s, bgCol);
  shownFrame = f;
  // frame label
  tft.fillRect(0, 148, 128, 12, bgCol);
  tft.setTextSize(1); tft.setTextColor(C_TEXT, bgCol); tft.setCursor(2, 150);
  if (st.names) tft.printf("%s  %lu us", st.names[f], (unsigned long)lastDrawUs);
  else          tft.printf("frame %u  %lu us", f, (unsigned long)lastDrawUs);
}

void play(const Step* s, uint8_t n, bool loops) {
  script = s; scriptLen = n; stepIdx = 0; scriptLoops = loops; stepStart = millis();
  if (!manual) showFrame(script[0].frame);
}

void playIdle() { const StageDef& st = STAGES[stageIdx]; play(st.idle, st.nIdle, true); }

void enterStage(uint8_t i) {
  stageIdx = i; actionIdx = 0; manualFrame = 0;
  tft.fillScreen(bgCol);
  tft.setTextSize(1); tft.setTextColor(C_TEXT, bgCol); tft.setCursor(2, 3);
  const Sprite& s = STAGES[i].frames[0];
  tft.printf("%s  %ux%u", STAGES[i].name, s.w, s.h);
  shownFrame = -1;
  if (manual) showFrame(0); else playIdle();
  Serial.printf("Stage -> %s (%u frames, %ux%u)\n", STAGES[i].name, STAGES[i].nFrames, s.w, s.h);
}

void tickPlayer() {
  if (manual || !script) return;
  if (millis() - stepStart < script[stepIdx].ms) return;
  stepStart = millis();
  stepIdx++;
  if (stepIdx >= scriptLen) {
    if (scriptLoops) stepIdx = 0;
    else { playIdle(); return; }          // one-shot finished -> back to idle
  }
  if (script[stepIdx].frame != shownFrame) showFrame(script[stepIdx].frame);
}

// ---------------------------------------------------------------------
uint32_t maxLoopUs = 0;

void printStatus() {
  Serial.printf("[status] cpu=%u MHz stage=%s frame=%d lastDraw=%lu us maxLoop=%lu us frames=%u bytes heap=%u freeSketch=%u\n", ESP.getCpuFreqMHz(),
                STAGES[stageIdx].name, shownFrame, (unsigned long)lastDrawUs, (unsigned long)maxLoopUs,
                PET_FRAMES_BYTES, ESP.getFreeHeap(), ESP.getFreeSketchSpace());
  maxLoopUs = 0;
}

void handleSerial() {
  while (Serial.available()) {
    char c = Serial.read();
    if (c == '\r' || c == '\n' || c == ' ') continue;
    const StageDef& st = STAGES[stageIdx];
    switch (c) {
      case 'n': enterStage((stageIdx + 1) % N_STAGES); break;
      case 'a':
        if (!st.nActions) { Serial.println("No actions in this stage"); break; }
        oneShot[0] = { st.actions[actionIdx], 2000 };
        Serial.printf("Action: %s\n", st.names[st.actions[actionIdx]]);
        actionIdx = (actionIdx + 1) % st.nActions;
        manual = false; play(oneShot, 1, false);
        break;
      case 'h':
        if (stageIdx != 0) { Serial.println("Hatch only in EGG stage"); break; }
        Serial.println("Hatching..."); manual = false; play(EGG_HATCH, N(EGG_HATCH), false);
        break;
      case 'm':
        if (!manual) { manual = true; manualFrame = 0; }
        else manualFrame = (manualFrame + 1) % st.nFrames;
        showFrame(manualFrame);
        Serial.printf("Manual frame %u/%u  draw=%lu us (send any other command to leave)\n",
                      manualFrame + 1, st.nFrames, (unsigned long)lastDrawUs);
        break;
      case 'b': bgCol = (bgCol == C_NAVY) ? ST77XX_BLACK : C_NAVY; enterStage(stageIdx); break;
      case 't': {
        uint8_t f = shownFrame < 0 ? 0 : shownFrame;
        uint32_t sum = 0, mx = 0;
        for (int i = 0; i < 50; i++) { showFrame(f); sum += lastDrawUs; if (lastDrawUs > mx) mx = lastDrawUs; yield(); }
        Serial.printf("Timing %s frame %u (%ux%u): avg %lu us, max %lu us\n", st.name, f,
                      st.frames[f].w, st.frames[f].h, (unsigned long)(sum / 50), (unsigned long)mx);
        break;
      }
      case '?': printStatus(); break;
    }
    if (c != 'm' && c != '?' && c != 't') manual = false;
  }
}

uint32_t lastLog = 0;

void setup() {
  Serial.begin(115200);
  delay(200);
  analogWriteRange(1023);
  analogWriteFreq(1000);
  analogWrite(TFT_LED, 1023);
  tft.initR(INITR_BLACKTAB);
  tft.setRotation(0);
  tft.setSPISpeed(SPI_HZ);
  Serial.println("\nStage 3b - fast draw @40 MHz. n stage, a action, h hatch, m manual, b bg, t timing, ? status");
  enterStage(0);
  printStatus();
}

void loop() {
  uint32_t t0 = micros();
  handleSerial();
  tickPlayer();
  if (millis() - lastLog >= 15000) { lastLog = millis(); printStatus(); }
  uint32_t dt = micros() - t0;
  if (dt > maxLoopUs) maxLoopUs = dt;
  yield();
}
